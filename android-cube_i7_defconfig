## android-cube_i7_defconfig
```kconfig
CONFIG_APB_TIMER=y
CONFIG_ARCH_HIBERNATION_HEADER=y
CONFIG_BT=y
CONFIG_BT_HCIUART_AG6XX=y
CONFIG_CPU_FREQ_GOV_INTERACTIVE=y
CONFIG_CRYPTO_CMAC=y
CONFIG_DECOMPRESS_LZ4=y
CONFIG_DEFAULT_HOSTNAME="android_cubei7"
CONFIG_DEFAULT_SECURITY="selinux"
CONFIG_DEFAULT_SECURITY_SELINUX=y
CONFIG_DEFAULT_USE_ENERGY_AWARE=y
CONFIG_DMAR_TABLE=y
CONFIG_DRM=y
CONFIG_DRM_DP_AUX_CHARDEV=y
CONFIG_DRM_I915=y
CONFIG_DRM_KMS_HELPER=y
CONFIG_DW_APB_TIMER=y
CONFIG_EFI_VARS=y
CONFIG_EFI_VARS_PSTORE=y
CONFIG_F2FS_FS=y
CONFIG_FB_SYS_COPYAREA=y
CONFIG_FB_SYS_FILLRECT=y
CONFIG_FB_SYS_FOPS=y
CONFIG_FB_SYS_IMAGEBLIT=y
CONFIG_HAVE_INTEL_TXT=y
CONFIG_HIBERNATE_CALLBACKS=y
CONFIG_HIBERNATION=y
CONFIG_I2C_ALGOBIT=y
CONFIG_I7300_IDLE=y
CONFIG_I7300_IDLE_IOAT_CHANNEL=y
CONFIG_INPUT_LEDS=m
CONFIG_INTEL_IOMMU=y
CONFIG_INTEL_IOMMU_DEFAULT_ON=y
CONFIG_INTEL_IOMMU_FLOPPY_WA=y
CONFIG_INTEL_IOMMU_SVM=y
CONFIG_INTEL_ISH_HID=m
CONFIG_INTEL_MEI=m
CONFIG_INTEL_MEI_ME=m
CONFIG_INTEL_SCU_IPC=y
CONFIG_INTEL_SCU_IPC_UTIL=y
CONFIG_IOMMU_API=y
CONFIG_IOMMU_IOVA=y
CONFIG_KERNEL_LZ4=y
CONFIG_LEDS_CLASS=m
CONFIG_LZ4_COMPRESS=y
CONFIG_LZ4_DECOMPRESS=y
CONFIG_MFD_INTEL_MSIC=y
CONFIG_MPSC=y
CONFIG_OF_IOMMU=y
CONFIG_PCI_PASID=y
CONFIG_PM_STD_PARTITION=""
CONFIG_PSTORE_LZ4_COMPRESS=y
CONFIG_RD_LZ4=y
CONFIG_RTC_DRV_VRTC=y
CONFIG_SECURITY_PATH=y
CONFIG_SECURITY_SELINUX_BOOTPARAM=y
CONFIG_SECURITY_SELINUX_BOOTPARAM_VALUE=1
CONFIG_SND=y
CONFIG_SOUND=y
CONFIG_SQUASHFS_LZ4=y
CONFIG_TOUCHSCREEN_INTEL_MID=m
CONFIG_TOUCHSCREEN_MELFAS_MIP4=m
CONFIG_TOUCHSCREEN_WM9705=y
CONFIG_TOUCHSCREEN_WM9712=y
CONFIG_TOUCHSCREEN_WM9713=y
CONFIG_TOUCHSCREEN_WM97XX=m
CONFIG_VIRTIO_MMIO=y
CONFIG_X86_INTEL_MID=y
CONFIG_X86_INTERNODE_CACHE_SHIFT=7
CONFIG_X86_L1_CACHE_SHIFT=7
CONFIG_X86_P4_CLOCKMOD=y
CONFIG_X86_P6_NOP=y
CONFIG_X86_SPEEDSTEP_LIB=y
```
